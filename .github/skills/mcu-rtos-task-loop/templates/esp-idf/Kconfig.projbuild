## .github/skills/mcu-rtos-task-loop/templates/esp-idf/Kconfig.projbuild
```kconfig
menu "App"

    config APP_SAMPLE_INTERVAL_MS
        int "Sampling period (ms)"
        range 100 60000
        default 2000

    config APP_TASK_STACK_MAIN_BYTES
        int "Main task stack (bytes)"
        range 2048 32768
        default 4096

    config APP_TASK_STACK_WORKER_BYTES
        int "Worker task stack (bytes)"
        range 2048 32768
        default 6144

endmenu
```

## .github/skills/mcu-rtos-task-loop/templates/esp-idf/sdkconfig.defaults
```kconfig
# 固定目标，避免无 sdkconfig 时默认构建成 esp32
CONFIG_IDF_TARGET="esp32c3"

# 2MB flash + 1.9MB app 分区
CONFIG_ESPTOOLPY_FLASHSIZE_2MB=y
CONFIG_ESPTOOLPY_FLASHSIZE="2MB"
CONFIG_PARTITION_TABLE_CUSTOM=y
CONFIG_PARTITION_TABLE_CUSTOM_FILENAME="partitions.csv"

# RTOS / C++ 运行时
CONFIG_FREERTOS_HZ=100
CONFIG_ESP_MAIN_TASK_STACK_SIZE=4096
CONFIG_COMPILER_CXX_EXCEPTIONS=n
CONFIG_COMPILER_CXX_RTTI=n
```
